## sim-utils/Kconfig
```kconfig
mainmenu "Simulator Configuration Menu"

choice
	prompt "Simulator"
config SIM_NEMU
	bool "NEMU"
config SIM_NPC
	bool "npc"
endchoice

config SIM
  string 
  default "nemu" if SIM_NEMU
  default "npc"  if SIM_NPC

config UPPER_SIM
  string 
  default "NEMU" if SIM_NEMU
  default "NPC" if SIM_NPC

# This Kconfig is used in config.mk, which would be included in nemu(npc)/makefile

choice
  prompt "Running mode"
  default MODE_SYSTEM

config MODE_SYSTEM
  bool "System mode"
  help
    Support full-system functionality, including privileged instructions, MMU and devices.
endchoice

if MODE_SYSTEM
	source "../sim-utils/scripts/memory/Kconfig"
	source "../sim-utils/scripts/device/Kconfig"
endif

choice
  prompt "Build target"
  default TARGET_NATIVE_ELF
config TARGET_NATIVE_ELF
  bool "Executable on Linux Native"
config TARGET_SHARE
  bool "Shared object (used as REF for differential testing)"
config TARGET_AM
  bool "Application on Abstract-Machine (DON'T CHOOSE)"
endchoice

choice
  prompt "Base ISA"
  default ISA_riscv
config ISA_x86
  bool "x86"
config ISA_mips32
  bool "mips32"
config ISA_riscv
  bool "riscv"
config ISA_loongarch32r
  bool "loongarch32r"
endchoice

config ISA
  string
  default "x86" if ISA_x86
  default "mips32" if ISA_mips32
  default "riscv32" if ISA_riscv && !RV64
  default "riscv64" if ISA_riscv &&  RV64
  default "loongarch32r" if ISA_loongarch32r
  default "none"

config ISA64
  depends on ISA_riscv && RV64
  bool
  default y


if ISA_riscv
source "../sim-utils/scripts/isa/riscv32/Kconfig"
endif


menu "Testing and Debugging"
menu "Trace"
config TRACE
  bool "Enable tracer"
  default y

config TRACE_START
  depends on TRACE
  int "When tracing is enabled (unit: number of instructions)"
  default 0

config TRACE_END
  depends on TRACE
  int "When tracing is disabled (unit: number of instructions)"
  default 10000

config ITRACE
  depends on TRACE && (SIM_NPC || (TARGET_NATIVE_ELF && ENGINE_INTERPRETER))
  # depends on TRACE && (SIM_NPC || (ENGINE_INTERPRETER))
  bool "Enable instruction tracer"
  default y

config IRINGBUF
  depends on ITRACE
  bool "Enable instruction trace ring buffer"
  default y

config IRINGBUFSIZE
  depends on IRINGBUF
  int "Size of instrution trace ring buffer"
  default 1000

config ITRACE_COND
  depends on ITRACE
  string "Only trace instructions when the condition is true"
  default "true"

config BATCH_ITRACE
  depends on ITRACE
  bool "Trace without flush the log file"
  default n


config MTRACE
  depends on TRACE && (SIM_NPC || (TARGET_NATIVE_ELF && ENGINE_INTERPRETER))
  bool "Enable memory tracer"
  default n

config FTRACE
  depends on TRACE && (SIM_NPC || TARGET_NATIVE_ELF && ENGINE_INTERPRETER)
  bool "Enable function tracer"
  default n
endmenu

config DIFFTEST
  depends on TARGET_NATIVE_ELF
  bool "Enable differential testing"
  default n
  help
    Enable differential testing with a reference design.
    Note that this will significantly reduce the performance of NEMU.

choice
  prompt "Reference design"
  default DIFFTEST_REF_NEMU  if SIM_NPC
  default DIFFTEST_REF_SPIKE if ISA_riscv
  default DIFFTEST_REF_KVM if ISA_x86
  default DIFFTEST_REF_QEMU
  depends on DIFFTEST
config DIFFTEST_REF_QEMU
  bool "QEMU, communicate with socket"

if ISA_riscv && SIM_NPC
config DIFFTEST_REF_NEMU
  bool "Nemu"
endif
if ISA_riscv
config DIFFTEST_REF_SPIKE
  bool "Spike"
endif
if ISA_x86
config DIFFTEST_REF_KVM
  bool "KVM"
endif
endchoice

config DIFFTEST_REF_PATH
  string
  default "../sim-utils/tools/qemu-diff" if DIFFTEST_REF_QEMU
  default "../sim-utils/tools/kvm-diff" if DIFFTEST_REF_KVM
  default "../sim-utils/tools/spike-diff" if DIFFTEST_REF_SPIKE
  default "../sim-utils/tools/nemu-diff" if DIFFTEST_REF_NEMU
  default "none"

config DIFFTEST_REF_NAME
  string
  default "qemu" if DIFFTEST_REF_QEMU
  default "kvm" if DIFFTEST_REF_KVM
  default "spike" if DIFFTEST_REF_SPIKE
  default "nemu" if DIFFTEST_REF_NEMU
  default "none"


endmenu

menu "NEMU CONFIGS"
 	depends on SIM_NEMU
if SIM_NEMU
	source "../sim-utils/scripts/nemu/Kconfig"
endif
endmenu
```
